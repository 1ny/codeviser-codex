; {
;   "interface": 1,
;   "safe": true,
;   "arguments": {}
; }

SYStem.Up
