; {
;   "interface": 1,
;   "safe": true,
;   "arguments": {}
; }

PRINT "CodeViser MCP script interface ready"
